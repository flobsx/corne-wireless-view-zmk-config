default_layer {
      display-name = "Base";
      bindings = <
//╭──────────┬──────────┬──────────┬──────────┬──────────┬──────────╮   ╭──────────┬──────────┬──────────┬──────────┬──────────┬──────────╮
//│  ESC     │  Z       │  J       │  O       │  B       │  !?      │   │  F       │  D       │  L       │  ★       │  X       │ BACKSPACE│
 &kp ESC    &kp FR_Z   &kp FR_J   &kp FR_O   &kp FR_B   &excl_ques     &kp FR_F   &kp FR_D   &kp FR_L   &kp A      &kp FR_X   &kp BSPC
//├──────────┼──────────┼──────────┼──────────┼──────────┼──────────┤   ├──────────┼──────────┼──────────┼──────────┼──────────┼──────────┤
//│  TAB     │  A       │  I       │  E       │  U       │  ,       │   │  P       │  T       │  S       │  R       │  N       │  DELETE  │
 &kp TAB    &kp FR_A   &kp FR_I   &kp FR_E   &kp FR_U   &comma_semi    &kp FR_P   &kp FR_T   &kp FR_S   &kp FR_R   &kp FR_N   &kp DEL
//├──────────┼──────────┼──────────┼──────────┼──────────┼──────────┤   ├──────────┼──────────┼──────────┼──────────┼──────────┼──────────┤
//│  ⇧       │  K       │  Y       │  Q       │  W       │  .       │   │  G       │ C        │ M        │ H        │ V        │  ⇧       │
 &kp LSHFT  &kp FR_K   &kp FR_Y   &kp FR_Q   &kp FR_W   &dot_colon     &kp FR_G   &kp FR_C   &kp FR_M   &kp FR_H   &kp FR_V   &kp RSHFT
//╰──────────┴──────────┴──────────┼──────────┼──────────┼──────────┤   ├──────────┼──────────┼──────────┼──────────┴──────────┴──────────╯
//                                 |          |          |          |   |          |          |          |                                  
                                  &kp LGUI   &kp BSPC   &lt Left SPACE &lt Right RET &mo DEL  &kp RALT
//                                 ╰──────────┴──────────┴──────────╯   ╰──────────┴──────────┴──────────╯
      >;
};


// default_layer {
// display-name = "Base";
// bindings = <
// //╭──────────┬──────────┬──────────┬──────────┬──────────┬──────────╮   ╭──────────┬──────────┬──────────┬──────────┬──────────┬──────────╮
// //│  ESC     │  A       │  Z       │  E       │  R       │  T       │   │  Y       │  U       │  I       │  O       │  P       │ BACKSPACE│
// &kp ESC     &kp Q      &kp W      &kp E      &kp R      &kp T          &kp Y      &kp U      &kp I      &kp O      &kp P      &kp BSPC
// //├──────────┼──────────┼──────────┼──────────┼──────────┼──────────┤   ├──────────┼──────────┼──────────┼──────────┼──────────┼──────────┤
// //│  TAB     │  Q       │  S       │  D       │  F       │  G       │   │  H       │  J       │  K       │  L       │  M       │  DELETE  │
// &kp TAB     HRML( A,       S,         D,         F)     &kp G          &kp H      HRMR(J,        K,         L,        SEMI)   &kp DEL
// //├──────────┼──────────┼──────────┼──────────┼──────────┼──────────┤   ├──────────┼──────────┼──────────┼──────────┼──────────┼──────────┤
// //│          │  W       │  X       │  C       │  V       │  B       │   │  N       │ ,?       │ ;.       │ :/       │ =+       │  -_      │
// &kp LSHIFT  &kp Z      &kp X      &kp C      &kp V      &kp B          &kp N     &kp M      &kp COMMA  &kp DOT    &kp FSLH    &kp EQUAL
// //╰──────────┴──────────┴──────────┴──────────┼──────────┼──────────┤   ├──────────┼──────────┼──────────┴──────────┴──────────┴──────────╯
//                                     &kp LSHIFT &lt LEF BSPC &kp SPACE     &kp ENTER  &lt RIG ESC &kp TAB
// //                                 ╰──────────┴──────────┴──────────╯   ╰──────────┴──────────┴──────────╯
// >;
// };