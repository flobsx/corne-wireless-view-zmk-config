                lower_layer {
// -----------------------------------------------------------------------------------------
// |  TAB |  1  |  2  |  3  |  4  |  5  |   |  6  |  7  |  8  |  9  |  0  | BKSP |
// | BTCLR| BT1 | BT2 | BT3 | BT4 | BT5 |   | LFT | DWN |  UP | RGT |     |      |
// | SHFT |     |     |     |     |     |   |     |     |     |     |     |      |
//                    | GUI |     | SPC |   | ENT |     | ALT |
                        display-name = "Lower";
                        bindings = <
   &kp TAB    &kp N1       &kp N2       &kp N3       &kp N4       &kp N5         &kp N6   &kp N7   &kp N8 &kp N9    &kp N0 &kp BSPC
   &bt BT_CLR &bt BT_SEL 0 &bt BT_SEL 1 &bt BT_SEL 2 &bt BT_SEL 3 &bt BT_SEL 4   &kp LEFT &kp DOWN &kp UP &kp RIGHT &trans &trans
   &kp LSHFT  &trans       &trans       &trans       &trans       &trans         &trans   &trans   &trans &trans    &trans &trans
                          	        &kp LGUI     &trans       &kp SPACE      &kp RET  &trans   &kp RALT
                        >;
                };

// lower_layer {
//         display-name = "Lower";
//         bindings = <
// //╭──────────┬──────────┬──────────┬──────────┬──────────┬──────────╮   ╭──────────┬──────────┬──────────┬──────────┬──────────┬──────────╮
// //│          │  *       │  1       │  2       │  3       │  +       │   │          │  HOME    │  UP      │  END     │  PAGE UP │          │
//   &trans    &kp LS(RBKT) &kp EXCL   &kp AT     &kp HASH   &kp LS(FSLH)   &none      &kp HOME   &kp UARW   &kp END    &kp PG_UP  &trans
// //├──────────┼──────────┼──────────┼──────────┼──────────┼──────────┤   ├──────────┼──────────┼──────────┼──────────┼──────────┼──────────┤
// //│          │  /       │  4       │  5       │  6       │  -       │   │          │ LEFT     │ DOWN     │ RIGHT    │  PAGE DN            │
//   &trans    &kp LS(DOT) &kp DLLR   &kp PRCNT  &kp CARET  &kp EQUAL      &none     &kp LARW   &kp DARW   &kp RARW    &kp PG_DN  &trans
// //├──────────┼──────────┼──────────┼──────────┼──────────┼──────────┤   ├──────────┼──────────┼──────────┼──────────┼──────────┼──────────┤
// //│          │  .       │  7       │  8       │  9       │  0       │   │          │          │  MENU    │          │          │          │
//   &trans    &kp LS(COMMA) &kp AMPS  &kp ASTRK  &kp LPAR   &kp RPAR       &none      &none     &kp K_APP   &none      &none      &trans
// //╰──────────┴──────────┴──────────┴──────────┼──────────┼──────────┤   ├──────────┼──────────┼──────────┴──────────┴──────────┴──────────╯
//                                    &trans     &trans     &trans         &trans     &trans     &trans
// //                                 ╰──────────┴──────────┴──────────╯   ╰──────────┴──────────┴──────────╯
//         >;
// };