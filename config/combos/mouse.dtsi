// Define combo for Space+Enter to toggle between main and fourth layer
toggle_mouse_layer {
    key-positions = <38 39>;
    timeout-ms = <50>;
    bindings = <&tog MOUSE>;
    // Prevent accidental activation
    require-prior-idle-ms = <100>;
    layers = <0 4>;  // Only active in layer 0 (default) and layer 4
};